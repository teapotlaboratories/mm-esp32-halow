## Kconfig
```kconfig
# Copyright 2025-2026 Morse Micro
# SPDX-License-Identifier: Apache-2.0

rsource "components/mmpktmem/Kconfig"
rsource "components/shims/Kconfig"
rsource "components/regdb/Kconfig"

menu "Wi-Fi HaLow Connection Manager"

    config WIFI_HALOW
        bool "Enable Morse Micro Wi-Fi HaLow support"
        default y
        select MBEDTLS_NIST_KW_C

    config HALOW_COUNTRY_CODE
        string "Country code to use for Wi-Fi HaLow"
        default "??"

	config HALOW_PS_MODE
		bool "Enable Morse Micro HaLow Powersave Mode"
		default false
		help
			This can only be set to true for devices which have the BUSY and WAKE
			pins connected.

    config HALOW_AP_MODE
        bool "Enable HaLow AP-mode support"
        default n
        help
            Adds requisite components for AP-mode viathe HaLow interface. This
            is disabled by default due to the extra functionality increasing the
            flash and ram requirements by a non inconsequential amount.

    config HALOW_AP_MAX_STAS
        int "Max stations the HaLow AP will accept"
        default 20
        range 1 255
        help
            Hard ceiling on associated stations for the HaLow AP (overrides the
            morselib default of 20). Each STA costs ~912 B of host RAM for its
            umac_sta_data plus per-STA buffers (see HALOW_STA_DATA_IN_PSRAM); the
            per-vif TWT agreement table is sized to this too. At high counts enable
            HALOW_STA_DATA_IN_PSRAM so this state comes from PSRAM, not internal SRAM.

            Upper bound 255: morselib's S1G TIM spans four partial-virtual-bitmap
            blocks (MAX_SUPPORTED_AID = 256 in traffic_bitmap.h; the s1g_tim.c encoder
            emits multiple blocks), so valid AIDs are 1..255. 255 is also the ceiling
            of the public uint8_t mmwlan_ap_args.max_stas field; going higher needs
            that widened to uint16_t. Values >20 are experimental (untested by the
            vendor) and the MM6108 firmware's true concurrent-STA capacity is its own
            (unpublished) limit; 255 is exercised here only as a build/structural test.

    config HALOW_STA_DATA_IN_PSRAM
        bool "Allocate per-STA AP state in PSRAM"
        default n
        help
            Route per-STA AP state to PSRAM (MALLOC_CAP_SPIRAM) instead of internal
            SRAM. Covers both (a) each associated station's umac_sta_data (~912 B,
            heap) and (b) the per-vif TWT agreement table inside umac_data (the
            agreements[]/responder_peers[] arrays, sized to HALOW_AP_MAX_STAS) which is
            otherwise static .bss in internal SRAM. By default umac_sta_data stays in
            internal SRAM (below SPIRAM_MALLOC_ALWAYSINTERNAL) and the TWT table is
            .bss, both of which bound how many STAs fit. Enable this when
            HALOW_AP_MAX_STAS is large so this state comes from the (much larger) PSRAM
            pool. Allocation is strict PSRAM with no internal-SRAM fallback. Requires
            CONFIG_SPIRAM.

endmenu
```

## components/mmpktmem/Kconfig
```kconfig
# Copyright 2024 Morse Micro
# SPDX-License-Identifier: Apache-2.0

menu "Morse Micro Packet Memory Configuration"
    config MMPKTMEM_TX_POOL_N_BLOCKS
        int "TX queue blocks"
        default 32
        help
            Number of blocks allocated for the transmit queue

    config MMPKTMEM_RX_POOL_N_BLOCKS
        int "RX queue blocks"
        default 32
        help
            Number of blocks allocated for the receive queue
endmenu
```

## components/regdb/Kconfig
```kconfig
menu "Regulatory Database"

choice WIFI_MORSE_AU_CHANNELISATION
	prompt "Australian channelisation configuration"
	default WIFI_MORSE_AU_CHANNELISATION_REVMF
	help
		Australia's channelisation rules for 802.11ah changed in the 2024
		version of the 802.11 standard. Additionally, there is a proposal for
		2028 which includes better positioned 8 MHz channels.

	config WIFI_MORSE_AU_CHANNELISATION_2020
		bool "s1g_channel_list_au_80211_2020"

	config WIFI_MORSE_AU_CHANNELISATION_2024
		bool "s1g_channel_list_au_80211_2024"

	config WIFI_MORSE_AU_CHANNELISATION_REVMF
		bool "s1g_channel_list_au_80211_revmf"

endchoice

endmenu
```

## components/shims/Kconfig
```kconfig
# Copyright 2024-2026 Morse Micro
# SPDX-License-Identifier: Apache-2.0
menu "Morse Micro Shim Configuration"
    config MM_RESET_N
        int "RESET_N pin for MM chip"
        default 2
        help
            Output gpio pin used to control the RESET_N line.

    config MM_WAKE
        int "WAKE pin for MM chip"
        default 3
        help
            Output gpio pin used to control the WAKE line.

    config MM_BUSY
        int "BUSY pin for the MM chip"
        default 6
        help
            Input pin used as a rising edge interrupt.

    config MM_SPI_SCK
        int "SCK pin for MM chip"
        default 8
        help
            SPI clock pin.

    config MM_SPI_MOSI
        int "MOSI pin for MM chip"
        default 10
        help
            SPI master out slave in pin.

    config MM_SPI_MISO
        int "MISO pin for MM chip"
        default 9
        help
            SPI master in slave out pin.

    config MM_SPI_CS
        int "SPI CS pin for MM chip"
        default 5
        help
            SPI chip select pin.

    config MM_SPI_IRQ
        int "SPI IRQ pin for MM chip"
        default 4
        help
            Out of band interupt pin used to indicate that
            the MM chip has data for the host.

endmenu
```

## examples/dual_if/main/Kconfig.projbuild
```kconfig
# Copyright 2026 Morse Micro
#
# SPDX-License-Identifier: Apache-2.0

config HALOW_SSID
	string "Wi-Fi SSID"
	default "MorseMicro"

config HALOW_PSK
	string "Wi-Fi Password"
	default "12345678"
```

## examples/dual_if/sdkconfig.defaults
```kconfig
# Copyright 2026 Morse Micro
#
# SPDX-License-Identifier: Apache-2.0

CONFIG_PARTITION_TABLE_CUSTOM=y
CONFIG_PARTITION_TABLE_FILENAME="partitions.csv"
CONFIG_ESPTOOLPY_FLASHSIZE_4MB=y
```

## examples/iperf/main/Kconfig.projbuild
```kconfig
# Copyright 2026 Morse Micro
#
# SPDX-License-Identifier: Apache-2.0

config WIFI_SSID
	string "Wi-Fi SSID"
	default "MorseMicro"

config WIFI_PSK
	string "Wi-Fi Password"
	default "12345678"
```

## examples/porting_assistant/sdkconfig.defaults
```kconfig
# Copyright 2026 Morse Micro
#
# SPDX-License-Identifier: Apache-2.0

CONFIG_FREERTOS_HZ=1000

CONFIG_IDF_TARGET="esp32s3"
```

## examples/softap/main/Kconfig.projbuild
```kconfig
# Copyright 2026 Morse Micro
#
# SPDX-License-Identifier: Apache-2.0

config WIFI_SSID
	string "Wi-Fi SSID"
	default "MorseMicroESP32AP"

config WIFI_PSK
	string "Wi-Fi Password"
	default "12345678"

config S1G_CHANNEL
    int "S1G Channel"
    default 27

config S1G_OPCLASS
    int "S1G Op-Class"
    default 68
```

## examples/sta_connect/sdkconfig.defaults
```kconfig
# Copyright 2026 Morse Micro
#
# SPDX-License-Identifier: Apache-2.0

CONFIG_PARTITION_TABLE_SINGLE_APP_LARGE=y
```

## examples/sta_reboot/sdkconfig.defaults
```kconfig
# Copyright 2026 Morse Micro
#
# SPDX-License-Identifier: Apache-2.0

CONFIG_PARTITION_TABLE_SINGLE_APP_LARGE=y
CONFIG_FREERTOS_HZ=1000
```
